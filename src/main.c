#include <reg51.h>

/************************ 硬件与常量定义 ************************/
// 共阳数码管段码表 0~9 （a段对应最低位，dp小数点未使用）
unsigned char code seg_table[] = {0xC0, 0xF9, 0xA4, 0xB0, 0x99, 
                                   0x92, 0x82, 0xF8, 0x80, 0x90};

sbit key_add = P1^0;   // 计数增加按键：按下=低电平，松开=高电平
sbit key_clr = P1^1;   // 清零按键：按下=低电平，松开=高电平

unsigned char count = 0; // 计数变量，范围 0~99

/************************ 延时函数 ************************/
// 延时约 ms 毫秒（12MHz晶振下近似值，可根据实际晶振调整）
void delay_ms(unsigned int ms)
{
    unsigned int i, j;
    for(i = ms; i > 0; i--)
        for(j = 120; j > 0; j--);
}

/************************ 主函数 ************************/
void main(void)
{
    unsigned char shi, ge; // 十位、个位暂存变量
    
    while(1)
    {
        /***** 1. 处理计数增加按键（按住连发） *****/
        if(key_add == 0)        // 检测按键按下
        {
            delay_ms(10);       // 10ms消抖，滤除按键机械抖动
            if(key_add == 0)    // 消抖后确认按键真的按下
            {
                count++;           // 计数+1
                if(count > 99)     // 超过99则归零，实现00~99循环
                    count = 0;
                delay_ms(100);     // 连发间隔：控制数字增加的速度
            }
        }
        
        /***** 2. 处理清零按键（单击触发） *****/
        if(key_clr == 0)        // 检测按键按下
        {
            delay_ms(10);       // 消抖
            if(key_clr == 0)    // 确认按下
            {
                count = 0;         // 计数直接清零
                while(!key_clr);   // 等待按键松开，避免长按重复清零
            }
        }
        
        /***** 3. 拆分十位、个位，输出到数码管显示 *****/
        shi = count / 10;  // 计算十位
        ge  = count % 10;  // 计算个位
        
        P0 = seg_table[shi]; // P0口输出十位段码 → 左侧数码管
        P2 = seg_table[ge];  // P2口输出个位段码 → 右侧数码管
    }
}
